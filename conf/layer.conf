## conf/layer.conf
```bitbake
# We have a conf and classes directory, add to BBPATH
BBPATH .= ":${LAYERDIR}"
# We have recipes-* directories, add to BBFILES
BBFILES += "${LAYERDIR}/recipes-*/*/*.bb ${LAYERDIR}/recipes*/*/*.bbappend"

BBFILE_COLLECTIONS += "cqrecorder-rpi"
BBFILE_PATTERN_cqrecorder-rpi = "^${LAYERDIR}/"
BBFILE_PRIORITY_cqrecorder-rpi = "7"
```
